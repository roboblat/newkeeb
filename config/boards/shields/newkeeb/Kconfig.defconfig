## config/boards/shields/newkeeb/Kconfig.shield
```kconfig
# SPDX-License-Identifier: MIT

config SHIELD_NEWKEEB_LEFT
	def_bool $(shields_list_contains,newkeeb_left)

config SHIELD_NEWKEEB_RIGHT
	def_bool $(shields_list_contains,newkeeb_right)

config SHIELD_NEWKEEB_DONGLE
	def_bool $(shields_list_contains,newkeeb_dongle)

# Diagnostic-only standalone single-half build.
config SHIELD_NEWKEEB_TEST
	def_bool $(shields_list_contains,newkeeb_test)
```

## config/dts/bindings/zmk,input-processor-volume.yaml
```yaml
description: Volume control input processor for mapping scroll wheel to system volume up/down
compatible: "zmk,input-processor-volume"

include: base.yaml

properties:
  "#input-processor-cells":
    type: int
    const: 0
```
